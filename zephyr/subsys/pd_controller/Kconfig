## zephyr/subsys/pd_controller/Kconfig
```kconfig
# Copyright 2023 The ChromiumOS Authors
# Use of this source code is governed by a BSD-style license that can be
# found in the LICENSE file.

if PLATFORM_EC_USBC

rsource "Kconfig.usbc_altmode"

menuconfig USB_PDC_POWER_MGNT
	bool "Configure USB-C PD Controller"
	depends on PLATFORM_EC_USB_PD_TCPMV3
	default y
	select EVENTS
	help
	  Enable this to support configuring the USB-C power management
	  when using Power Delivery Controllers.

module = USB_PDC
module-str = USB PDC
source "subsys/logging/Kconfig.template.log_config"

endif # PLATFORM_EC_USBC
```

## zephyr/subsys/usb_dc/Kconfig.google_vendor
```kconfig
# Copyright 2024 The ChromiumOS Authors
# Use of this source code is governed by a BSD-style license that can be
# found in the LICENSE file.

if PLATFORM_EC_USB_I2C || PLATFORM_EC_USB_UPDATE

config NET_BUF
	default y

config GOOGLE_VENDOR_RX_THREAD_PRIORTY
	int "Google update RX thread priority"
	default 8
	help
	  Set thread priority of the Google vendor RX.

config GOOGLE_VENDOR_RX_STACK_SIZE
	int "Size of the Rx thread stack"
	default 2048
	help
	  Size of the Rx thread stack.

config GOOGLE_VENDOR_TX_THREAD_PRIORTY
	int "Google update TX thread priority"
	default 8
	help
	  Set thread priority of the Google vendor TX.

config GOOGLE_VENDOR_TX_STACK_SIZE
	int "Size of the Tx thread stack"
	default 1024
	help
	  Size of the Tx thread stack.

endif # PLATFORM_EC_USB_I2C || PLATFORM_EC_USB_UPDATE
```

## zephyr/test/charger/Kconfig
```kconfig
# Copyright 2024 The ChromiumOS Authors
# Use of this source code is governed by a BSD-style license that can be
# found in the LICENSE file.

choice TEST_BOARD_VARIANT
	prompt "Select board variant for tests"

	# Brox variants
	config TEST_BOARD_BROX
		bool "Run brox tests"

	# Nissa variants
	config TEST_BOARD_CRAASK
		bool "Run craask tests"

	config TEST_BOARD_CRAASKOV
		bool "Run craaskov tests"

	config TEST_BOARD_GOTHRAX
		bool "Run gothrax tests"

	config TEST_BOARD_NIVVIKS
		bool "Run nivvkis tests"

	config TEST_BOARD_PIRRHA
		bool "Run pirrha tests"

	config TEST_BOARD_PUJJO
		bool "Run pujjo tests"

	config TEST_BOARD_ULDREN
		bool "Run uldren tests"

	config TEST_BOARD_XIVU
		bool "Run xivu tests"

	config TEST_BOARD_XIVUR
		bool "Run xivur tests"
endchoice

choice TEST_CHARGER
	prompt "Select charger for tests"

	config TEST_ISL923X
		bool "Use ISL923x test variants"
		select ISL923X_MOCK

endchoice # TEST_CHARGER

config TEST_EXTPOWER
	bool "Run external power tests"

config TEST_SRC
	string "Path for the file to test"

source "Kconfig.zephyr"
```
