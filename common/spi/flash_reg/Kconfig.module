## zephyr/dts/bindings/battery/byd,jgcct.yaml
```yaml
description: "BYD DELL JGCCT"
compatible: "byd,jgcct"

include: battery-smart.yaml

properties:
  enum-name:
    type: string
    default: "byd,jgcct"

  # Fuel gauge
  manuf_name:
    default: "BYD"
  device_name:
    default: "DELL JGCCT"
  ship_mode_reg_addr:
    default: 0x00
  ship_mode_reg_data:
    default: [0x0010, 0x0010]
  fet_mfgacc_support:
    default: 1
  fet_mfgacc_smb_block:
    default: 1
  fet_reg_addr:
    default: 0x00
  fet_reg_mask:
    default: 0x2000
  fet_disconnect_val:
    default: 0x2000
  fet_cfet_mask:
    default: 0x0004
  fet_cfet_off_val:
    default: 0x0000

  # Battery info
  voltage_max:
    default: 17400
  voltage_normal:
    default: 15000
  voltage_min:
    default: 12000
  precharge_current:
    default: 256
  start_charging_min_c:
    default: 0
  start_charging_max_c:
    default: 60
  charging_min_c:
    default: 0
  charging_max_c:
    default: 60
  discharging_min_c:
    default: 0
  discharging_max_c:
    default: 70
```

## zephyr/dts/bindings/battery/smp,atln9xx1.yaml
```yaml
description: "SMP-ATL SMP-ATL4.24"
compatible: "smp,atln9xx1"

include: battery-smart.yaml

properties:
  enum-name:
    type: string
    default: "smp,atln9xx1"

  # Fuel gauge
  manuf_name:
    default: "SMP-ATL4.24"
  device_name:
    default: "DELL N9XX1"
  ship_mode_reg_addr:
    default: 0x00
  ship_mode_reg_data:
    default: [0x0010, 0x0010]
  fet_reg_addr:
    default: 0x00
  fet_reg_mask:
    default: 0x2000
  fet_disconnect_val:
    default: 0x2000
  fet_cfet_mask:
    default: 0x0002
  fet_cfet_off_val:
    default: 0x0000

  # Battery info
  voltage_max:
    default: 17800
  voltage_normal:
    default: 15200
  voltage_min:
    default: 12000
  precharge_current:
    default: 256
  start_charging_min_c:
    default: 0
  start_charging_max_c:
    default: 50
  charging_min_c:
    default: 0
  charging_max_c:
    default: 50
  discharging_min_c:
    default: -14
  discharging_max_c:
    default: 70
```

## zephyr/dts/bindings/fan/cros-ec,fan-steps.yaml
```yaml
# Copyright 2021 The ChromiumOS Authors
# Use of this source code is governed by a BSD-style license that can be
# found in the LICENSE file.

description: Fan steps parent node

compatible: "cros-ec,fan-steps"

child-binding:
  description: Fan_steps child node
  properties:
    temp_on:
      required: false
      type: array
      description:
        Temperature to trigger next fan level
    temp_off:
      required: false
      type: array
      description:
        Temperature to trigger previous fan level
    rpm_target:
      required: false
      type: array
      description:
        Fan speed for each level (in RPM)
```

## zephyr/dts/bindings/input/cros-ec,boot-keys.yaml
```yaml
# Copyright 2024 Google LLC
# Use of this source code is governed by a BSD-style license that can be
# found in the LICENSE file.

description: |
  Boot keys definition.

  This can be used to define the key combinations that trigger boot key events:
  recovery mode, force memory retraining and boot without starting the AP.

  Example configuration:

  boot-keys {
      compatible = "cros-ec,boot-keys";
      down-arrow-rc = <KBD_RC(2, 9)>;
      esc-rc = <KBD_RC(2, 9)>;
      left-shift-rc = <KBD_RC(2, 9)>;
      refresh-rc = <KBD_RC(2, 9)>;
  };

compatible: "cros-ec,boot-keys"

include: base.yaml

properties:
  down-arrow-rc:
    type: int
    required: true
    description: Row-column position of the "down arrow" key.

  esc-rc:
    type: int
    required: true
    description: Row-column position of the "esc" key.

  left-shift-rc:
    type: int
    required: true
    description: Row-column position of the "left shift" key.

  refresh-rc:
    type: int
    required: true
    description: Row-column position of the "refresh" key.
```

## zephyr/dts/bindings/motionsense/cros-ec,motionsense-mutex.yaml
```yaml
# Copyright (c) 2021 The Chromium OS Authors
# SPDX-License-Identifier: Apache-2.0

description: Motion sense mutex parent node

compatible: "cros-ec,motionsense-mutex"

child-binding:
  description: Mutex node which will be used by motion sensors
  properties:
    label:
      required: true
      type: string
      description: Human readable string describing the mutex
```

## zephyr/dts/bindings/motionsense/cros-ec,motionsense-rotation-ref.yaml
```yaml
# Copyright (c) 2021 The Chromium OS Authors
# SPDX-License-Identifier: Apache-2.0

description: Motion sense rotation reference parent node

compatible: "cros-ec,motionsense-rotation-ref"

child-binding:
  description: Motion sense rotation reference which will be used by motion sensors
  properties:
    mat33:
      required: true
      type: array
      description: 3x3 matrix to rotate x, y, and z axes.
```

## zephyr/dts/bindings/motionsense/cros-ec,motionsense-sensor-info.yaml
```yaml
# Copyright (c) 2021 The Chromium OS Authors
# SPDX-License-Identifier: Apache-2.0

description: ALS sensor information

compatible: "cros-ec,motionsense-sensor-info"

properties:
    als-sensors:
        type: phandles
        required: false
        description: list of ALS sensors.
    sensor-irqs:
        type: phandles
        required: false
        description: list of gpio interrupts from sensors to be enabled.
    accel-force-mode-sensors:
        type: phandles
        required: false
        description: list of sensors should be handled in force mode.
```

## zephyr/dts/bindings/motionsense/cros-ec,motionsense-sensor.yaml
```yaml
# Copyright (c) 2021 The Chromium OS Authors
# SPDX-License-Identifier: Apache-2.0

description: sensor information to create motion_sensor_t entry

compatible: "cros-ec,motionsense-sensor"

properties:
    label:
        type: string
        required: true
        description: Human readable string describing the device (used as device_get_binding() argument)
    active-mask:
        type: string
        required: true
        description: indicates system power state for sensor to be active
        enum:
            - "SENSOR_ACTIVE_S5"
            - "SENSOR_ACTIVE_S3"
            - "SENSOR_ACTIVE_S0"
            - "SENSOR_ACTIVE_S0_S3"
            - "SENSOR_ACTIVE_S0_S3_S5"
    location:
        type: string
        required: true
        description: location of the motion sensor
        enum:
            - "MOTIONSENSE_LOC_BASE"
            - "MOTIONSENSE_LOC_LID"
            - "MOTIONSENSE_LOC_CAMERA"
    mutex:
        type: phandle
        required: false
        description: mutex used by chip driver
    port:
        type: phandle
        required: false
        description: named i2c port
    rot-standard-ref:
        type: phandle
        required: false
        description: 3x3 rotation matrix
    default-range:
        type: int
        required: false
        description: default range
    drv-data:
        type: phandle
        required: false
        description: driver data
```

## zephyr/dts/bindings/motionsense/drvdata/cros-ec,accelgyro-als-channel-scale.yaml
```yaml
# Copyright (c) 2021 The Chromium OS Authors
# SPDX-License-Identifier: Apache-2.0

description: Bindings for als_channel_scale_t in accelgyro.h
             Each channel has scaling factor for normalization & cover

compatible: cros-ec,accelgyro-als-channel-scale

properties:
    k-channel-scale:
        type: int
        required: true
        description: Channel scale factor
    cover-scale:
        type: int
        required: true
        description: Cover compensation scale factor
```

## zephyr/dts/bindings/motionsense/drvdata/cros-ec,accelgyro-als-drv-data.yaml
```yaml
# Copyright (c) 2021 The Chromium OS Authors
# SPDX-License-Identifier: Apache-2.0

description: ALS driver data

compatible: "cros-ec,accelgyro-als-drv-data"

child-binding:
    description: ALS calibration data
    properties:
        scale:
            type: int
            required: true
            description: Scale, uscale, and offset are used to correct the raw 16 bit ALS data
                         and then to convert it to 32 bit using the following equations
                         raw_value += offset;
                         adjusted_value = raw_value * scale + raw_value * uscale / 10000;
        uscale:
            type: int
            required: true
            description: uscale
        offset:
            type: int
            required: true
            description: offset
```

## zephyr/dts/bindings/motionsense/drvdata/cros-ec,accelgyro-rgb-calibration.yaml
```yaml
# Copyright (c) 2021 The Chromium OS Authors
# SPDX-License-Identifier: Apache-2.0

description: bindings for rgb_calibration_t in accelgyro.h

compatible: "cros-ec,accelgyro-rgb-calibration"

properties:
    irt:
        type: int
        required: true
        description: incandecent scaling factor

child-binding:
    description: RGB ALS Calibration Data
    properties:
        offset:
            type: int
            required: true
            description: Any offset to add to raw channel data
        coeff:
            type: array
            required: true
            description: Clear, R, G, and B coefficients for this channel
```

## zephyr/dts/bindings/motionsense/drvdata/cros-ec,drvdata-bmi260.yaml
```yaml
# Copyright (c) 2021 The Chromium OS Authors
# SPDX-License-Identifier: Apache-2.0

description: BMI260 driver data node

compatible: "cros-ec,drvdata-bmi260"

include: base.yaml

properties:
    status:
      required: true
```

## zephyr/dts/bindings/motionsense/drvdata/cros-ec,drvdata-tcs3400-clear.yaml
```yaml
# Copyright (c) 2021 The Chromium OS Authors
# SPDX-License-Identifier: Apache-2.0

description: TCS3400 CLEAR driver data

compatible: "cros-ec,drvdata-tcs3400-clear"

include: base.yaml

properties:
    status:
        required: true
```

## zephyr/dts/bindings/motionsense/drvdata/cros-ec,drvdata-tcs3400-rgb.yaml
```yaml
# Copyright (c) 2021 The Chromium OS Authors
# SPDX-License-Identifier: Apache-2.0

description: TCS3400 RGB driver data

compatible: "cros-ec,drvdata-tcs3400-rgb"

include: base.yaml

properties:
    status:
        required: true
child-binding:
    description: saturation auto-adjustment
    properties:
        again:
            type: int
            required: false
            description: Gain Scaling; must be value between 0 and 3
        atime:
            type: int
            required: false
            description: Acquisition Time, controlled by the ATIME register
```

## zephyr/dts/bindings/motionsense/drvinfo/cros-ec,drv-bma255.yaml
```yaml
# Copyright (c) 2021 The Chromium OS Authors
# SPDX-License-Identifier: Apache-2.0

description: BMA255 driver node

compatible: "cros-ec,drv-bma255"

include: base.yaml

properties:
    status:
        required: true
    i2c-spi-addr-flags:
        type: string
        required: true
        description: i2c address or SPI slave logic GPIO
        enum:
            - "BMA2x2_I2C_ADDR1_FLAGS"
            - "BMA2x2_I2C_ADDR2_FLAGS"
            - "BMA2x2_I2C_ADDR3_FLAGS"
            - "BMA2x2_I2C_ADDR4_FLAGS"
```

## zephyr/dts/bindings/motionsense/drvinfo/cros-ec,drv-bmi260-accel.yaml
```yaml
# Copyright (c) 2021 The Chromium OS Authors
# SPDX-License-Identifier: Apache-2.0

description: BMI260 accel driver node

compatible: "cros-ec,drv-bmi260-accel"

include: drv-bmi260.yaml
```

## zephyr/dts/bindings/motionsense/drvinfo/cros-ec,drv-bmi260-gyro.yaml
```yaml
# Copyright (c) 2021 The Chromium OS Authors
# SPDX-License-Identifier: Apache-2.0

description: BMI260 gyro driver node

compatible: "cros-ec,drv-bmi260-gyro"

include: drv-bmi260.yaml
```

## zephyr/dts/bindings/motionsense/drvinfo/cros-ec,drv-tcs3400-clear.yaml
```yaml
# Copyright (c) 2021 The Chromium OS Authors
# SPDX-License-Identifier: Apache-2.0

description: TCS3400 CLEAR driver node

compatible: "cros-ec,drv-tcs3400-clear"

include: drv-tcs3400.yaml
```

## zephyr/dts/bindings/motionsense/drvinfo/cros-ec,drv-tcs3400-rgb.yaml
```yaml
# Copyright (c) 2021 The Chromium OS Authors
# SPDX-License-Identifier: Apache-2.0

description: TCS3400 RGB driver node

compatible: "cros-ec,drv-tcs3400-rgb"

include: drv-tcs3400.yaml
```

## zephyr/dts/bindings/motionsense/drvinfo/drv-bmi260.yaml
```yaml
# Copyright (c) 2021 The Chromium OS Authors
# SPDX-License-Identifier: Apache-2.0

include: base.yaml

properties:
    status:
        required: true
    i2c-spi-addr-flags:
        type: string
        required: true
        description: i2c address or SPI slave logic GPIO
        enum:
            - "BMI260_ADDR0_FLAGS"
```

## zephyr/dts/bindings/motionsense/drvinfo/drv-tcs3400.yaml
```yaml
# Copyright (c) 2021 The Chromium OS Authors
# SPDX-License-Identifier: Apache-2.0

include: base.yaml

properties:
    status:
        required: true
    i2c-spi-addr-flags:
        type: string
        required: false
        description: i2c address or SPI slave logic GPIO
        enum:
            - "TCS3400_I2C_ADDR_FLAGS"
```

## zephyr/dts/bindings/temp/thermistor.yaml
```yaml
# Copyright 2021 The Chromium OS Authors. All rights reserved.
# Use of this source code is governed by a BSD-style license that can be
# found in the LICENSE file.

description: Common properties for thermistors

compatible: thermistor

properties:
  adc:
    required: true
    type: phandle
    description: named-adc child node connected to the thermistor

  scaling-factor:
    required: false
    type: int
    description: "Scaling factor for voltage pairs"

  num-pairs:
    required: false
    type: int
    description: "Number of associated pairs between temp-c and scale-mv"

  temp-c:
    required: false
    type: array
    description: "Number of associated pairs between temp-c and scale-mv"

  scale-mv:
     required: false
     type: array
     description: "Number of associated pairs between temp-c and scale-mv"

  get-temp-func:
      type: string
      required: false
      description: >
        Name of the board-provided function which reads the temperature. If you
        have different values and need to add a new function, you can add that
        here.

        The name is get_temp_<v>_<rs>_<rn>_<b>:

          v: voltage of resistor-divider circuit
          rs: value of the resistor that is in series with the thermistor
          rn: nominal resistance of thermistor at 25C
          b: B value for temperature range 25C to 100C

          See https://www.electronics-tutorials.ws/io/thermistors.html for more
           information.
```
